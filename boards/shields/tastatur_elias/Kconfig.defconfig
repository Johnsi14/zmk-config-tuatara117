## boards/shields/tastatur_elias/Kconfig.defconfig
```kconfig
if SHIELD_TASTATUR_ELIAS

#Max 16 Characters
config ZMK_KEYBOARD_NAME
    default "Tastatur_Elias"

endif
```

## boards/shields/tastatur_elias/Kconfig.shield
```kconfig
config SHIELD_TASTATUR_ELIAS
    def_bool $(shields_list_contains,tastatur_elias)
```
